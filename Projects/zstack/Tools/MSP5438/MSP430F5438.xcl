/**************************************************************************************************
  Filename:       MSP430F5438.xcl
  Revised:        $Date: 2014-12-30 15:03:09 -0800 (Tue, 30 Dec 2014) $
  Revision:       $Revision: 41586 $

  Description:    This file is the XLINK command file for the MSP430 IAR C/EC++
                  Compiler, and targets the Texas Instruments MSP430F5438.

  Copyright 2010-2014 Texas Instruments Incorporated. All rights reserved.

  IMPORTANT: Your use of this Software is limited to those specific rights
  granted under the terms of a software license agreement between the user
  who downloaded the software, his/her employer (which must be your employer)
  and Texas Instruments Incorporated (the "License"). You may not use this
  Software unless you agree to abide by the terms of the License. The License
  limits your use, and you acknowledge, that the Software may not be modified,
  copied or distributed unless embedded on a Texas Instruments microcontroller
  or used solely and exclusively in conjunction with a Texas Instruments radio
  frequency transceiver, which is integrated into your product. Other than for
  the foregoing purpose, you may not use, reproduce, copy, prepare derivative
  works of, modify, distribute, perform, display or sell this Software and/or
  its documentation for any purpose.

  YOU FURTHER ACKNOWLEDGE AND AGREE THAT THE SOFTWARE AND DOCUMENTATION ARE
  PROVIDED “AS IS” WITHOUT WARRANTY OF ANY KIND, EITHER EXPRESS OR IMPLIED,
  INCLUDING WITHOUT LIMITATION, ANY WARRANTY OF MERCHANTABILITY, TITLE,
  NON-INFRINGEMENT AND FITNESS FOR A PARTICULAR PURPOSE. IN NO EVENT SHALL
  TEXAS INSTRUMENTS OR ITS LICENSORS BE LIABLE OR OBLIGATED UNDER CONTRACT,
  NEGLIGENCE, STRICT LIABILITY, CONTRIBUTION, BREACH OF WARRANTY, OR OTHER
  LEGAL EQUITABLE THEORY ANY DIRECT OR INDIRECT DAMAGES OR EXPENSES
  INCLUDING BUT NOT LIMITED TO ANY INCIDENTAL, SPECIAL, INDIRECT, PUNITIVE
  OR CONSEQUENTIAL DAMAGES, LOST PROFITS OR LOST DATA, COST OF PROCUREMENT
  OF SUBSTITUTE GOODS, TECHNOLOGY, SERVICES, OR ANY CLAIMS BY THIRD PARTIES
  (INCLUDING BUT NOT LIMITED TO ANY DEFENSE THEREOF), OR OTHER SIMILAR COSTS.

  Should you have any questions regarding your right to use this Software,
  contact Texas Instruments Incorporated at www.TI.com.
**************************************************************************************************/

//*****************************************************************
//
// Memory areas of the MSP430F5438/MSP430F5438A microprocessors:
//
//   Peripheral units:            00000 - 00FFF
//
//   Information memory (FLASH):  01800 - 019FF
//
//   Read/write memory (RAM):     01C00 - 05BFF
//
//   Read-only memory (FLASH):    05C00 - 0FFFF
//                                10000 - 45BFF
//
//*****************************************************************

//*****************************************************************
//
// The following segments are defined in this linker command file:
//
// Data read/write segments (RAM)
// ==============================
// The following segments are available for both
// the DATA16 and DATA20 segment groups.
//
// segment         Usage
// -------         --------------------------
// DATA<nn>_Z      Data initialized to zero
// DATA<nn>_I      Data initialized by copying from DATA<nn>_ID
// DATA<nn>_N      Data defined using __no_init
// DATA<nn>_HEAP   The heap used by 'malloc' and 'free'
//
// segment         Usage
// -------         --------------------------
// CSTACK          Runtime stack
//


// -------------------------------------------
// Program and data read-only segments (FLASH)
// ===========================================
// The following segments are available for both
// the DATA16 and DATA20 segment groups.
//
// segment         Usage
// -------         --------------------------
// DATA<nn>_C      Constant data, including string literals
// DATA<nn>_ID     Initializers for DATA<nn>_I
//
// segment         Usage
// -------         --------------------------
// INFO                        Information memory
// INFOA           Information memory, bank A
// INFOB           Information memory, bank B
// INFOC           Information memory, bank C
// INFOD           Information memory, bank D
// CSTART          Program startup code
// CODE            Program code
// ISR_CODE        Program code for interrupt service routines

// Program     5C00-C9FF       Code < 0x10000. See LO_ROM below.
// OSAL NV     CA00-F9FF       Reserving 24 pages for use by OSAL NV. See ZIGNV_BEG below.
// Program     FA00-FF7F       Code < 0x10000. See LO_ROM below.

// INTVEC      FF80-FFFF       Interrupt vectors
// RESET       FFFE-FFFF       The reset vector
//
// Notes:
//
// * The segments CSTART, ISR_CODE, and DIFUNCT, as well as the segments in
//   the DATA16 and TLS16 segment groups must be placed in in the range
//   0000-FFFD.
//
// * The INFOx and INFO segments overlap, this allows data either to be
//   placed in a specific bank or anywhere in the info memory.
//
// * The INTVEC and RESET segments overlap. This allows an application to
//   either use the reset vector provided by the runtime library, or
//   provide a reset function by defining an interrupt function associated
//   with the reset vector.
//
//*****************************************************************

-D_LO_ROM_BEG=0x05C00
-D_LO_ROM_END=0x0FF7F
-D_HI_ROM_BEG=0x10000
-D_HI_ROM_END=0x45BFF

// NV memory must coincide with declarations in "hal_board_cfg.h" file.
-D_ZIGNV_BEG=0x0CA00
-D_ZIGNV_END=0x0F9FF

// ---------------------------------------------------------
// Define cpu.

-cmsp430

// Compensate for hardware bug in CPU
-D?CPU30_OFFSET=2


// -----------------------------------------------
// Support for placing functions in read/write memory
//

-QCODE_I=CODE_ID


// -----------------------------------------------
// Support for thread local storage
//

-QTLS16_I=TLS16_ID


// -----------------------------------------------
// Hardware multiplier location
//

-D__iar_HWMUL=4C0


// ---------------------------------------------------------
// Read-write memory.

-Z(DATA)DATA16_I,DATA16_Z,DATA16_N,TLS16_I=1C00-5BFF
-Z(DATA)DATA16_HEAP+_DATA16_HEAP_SIZE
-Z(DATA)CODE_I
-Z(DATA)DATA20_I,DATA20_Z,DATA20_N,DATA20_HEAP+_DATA20_HEAP_SIZE
-Z(DATA)CSTACK+_STACK_SIZE#


// ---------------------------------------------------------
// Information memory

-Z(CODE)INFO=1800-19FF
-Z(CODE)INFOA=1980-19FF
-Z(CODE)INFOB=1900-197F
-Z(CODE)INFOC=1880-18FF
-Z(CODE)INFOD=1800-187F

// ---------------------------------------------------------
// Low memory only Code

-Z(CODE)CSTART,ISR_CODE=_LO_ROM_BEG-_LO_ROM_END

// ---------------------------------------------------------
// Internal flash used for NV address space.

-Z(CODE)ZIGNV_ADDRESS_SPACE=_ZIGNV_BEG-_ZIGNV_END

// ---------------------------------------------------------
// Interrupt vectors

-Z(CODE)INTVEC=FF80-FFFF
-Z(CODE)RESET=FFFE-FFFF

// ---------------------------------------------------------
// Constant data

-Z(CONST)DATA16_C,DATA16_ID,TLS16_ID,DIFUNCT=_LO_ROM_BEG-_LO_ROM_END
-Z(CONST)DATA20_C,DATA20_ID,CODE_ID=_LO_ROM_BEG-_LO_ROM_END

// ---------------------------------------------------------
// Code

-Z(CODE)CODE=_LO_ROM_BEG-_LO_ROM_END,_HI_ROM_BEG-_HI_ROM_END

